/dts-v1/;
/plugin/;

/ {
	compatible = "brcm,bcm2708";
	fragment@0 {
		target = <&spi0>;
		__overlay__ {
			#address-cells = <1>;
			#size-cells = <0>;			
			arduinomini@0{
				compatible = "arduinomini";
				reg = <0>;
				spi-max-frequency = <1000000>;
			};
		};
	};	
};
